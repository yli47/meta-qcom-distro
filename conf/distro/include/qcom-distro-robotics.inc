## conf/distro/qcom-distro-robotics-catchall.conf
```bitbake
require conf/distro/include/qcom-base.inc
require conf/distro/include/qcom-distro-robotics.inc
require conf/distro/include/qcom-distro-selinux.inc
require conf/distro/include/qcom-distro-sota.inc
```

## conf/distro/qcom-distro-robotics-sota.conf
```bitbake
require conf/distro/include/qcom-base.inc

#Robotics
require conf/distro/include/qcom-distro-robotics.inc

#SOTA
require conf/distro/include/qcom-distro-sota.inc
```
